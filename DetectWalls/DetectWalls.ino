// generated by mBlock5 for mBot
// codes make you happy

#include <MeMCore.h>
#include <Arduino.h>
#include <Wire.h>
#include <SoftwareSerial.h>

MeRGBLed led(7, 2);
MeUltrasonicSensor ultraSensor(3); /* Ultrasonic module can ONLY be connected to port 3, 4, 6, 7, 8 of base shield. */

MeLineFollower lineFinder(PORT_2); 

bool go = true;

MeDCMotor motor_m1(M1);
MeDCMotor motor_m2(M2);

MeIR ir;

void setup()
{
  ir.begin();  
  Serial.begin(9600);
  resetMotors();
}

void resetMotors() {
  motor_m1.reset(M1);
  motor_m2.reset(M2);
}

void stopMotors() {
  motor_m1.stop();
  motor_m2.stop();
}

void turnAround() {
  moveForward(255, 255);
  delay(500);
}

void loop()
{
  ir.loop();
  Serial.print("Distance : ");
  Serial.print(ultraSensor.distanceCm() );
  Serial.println(" cm");
  int sensorState = lineFinder.readSensors();
  if(ir.keyPressed(69)) {
    stopMotors();
  }
  else if(ir.keyPressed(70)) {
    turnAround();
  }
  else if (ultraSensor.distanceCm() <= 20 || sensorState != S1_OUT_S2_OUT) {
    led.setColor(1, 255, 0, 0);
    led.show();    
    turnAround();
  } else {
    led.setColor(1, 0, 255, 0);
    led.show();
    //resetMotors();
    moveForward(-64, 64);
  }
  delay(100); /* the minimal measure interval is 100 milliseconds */
}

void moveForward(int left, int right) {
  if (go) {
    motor_m1.run(left);
    motor_m2.run(right);
  }
}
